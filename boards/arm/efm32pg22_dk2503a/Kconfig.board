## boards/arm/efm32pg22_dk2503a/Kconfig.board
```kconfig
# EFM32PG22 DK2503A board

# Copyright (c) 2022 Immanuel Huebner  
# SPDX-License-Identifier: Apache-2.0

config BOARD_EFM32PG22_DK2503A
	bool "SiLabs EFM32PG22-DK2503A (Pearl Gecko)"
	depends on SOC_SERIES_EFM32PG22
	select SOC_PART_NUMBER_EFM32PG22C200F512IM40
```

## boards/arm/efm32pg22_dk2503a/Kconfig.defconfig
```kconfig
# EFM32PG22 DK2503A board 

# Copyright (c) 2022 Immanuel Huebner   
# SPDX-License-Identifier: Apache-2.0

if BOARD_EFM32PG22_DK2503A

config BOARD
	default "efm32pg22_dk2503a"

config CMU_HFXO_FREQ
	default 40000000

config CMU_LFXO_FREQ
	default 32768

config COUNTER_GECKO_RTCC
	default y
	depends on COUNTER

endif # BOARD_EFM32PG22_DK2503A
```

## soc/arm/silabs_exx32/efm32pg22/Kconfig.defconfig.series
```kconfig
# EFM32PG12B series configuration options

# Copyright (c) 2022 Immanuel Huebner 
# SPDX-License-Identifier: Apache-2.0

if SOC_SERIES_EFM32PG22

config SOC_SERIES
	default "efm32pg22"

config SOC_PART_NUMBER
	default "EFM32PG22C200F512IM40" if SOC_PART_NUMBER_EFM32PG22C200F512IM40

config NUM_IRQS
	# must be >= the highest interrupt number used
	default 63

source "soc/arm/silabs_exx32/efm32pg22/Kconfig.defconfig.efm32pg22"

endif # SOC_SERIES_EFM32PG22
```

## soc/arm/silabs_exx32/efm32pg22/Kconfig.series
```kconfig
# EFM32PG22 MCU line

# Copyright (c) 2022 Immanuel Huebner
# SPDX-License-Identifier: Apache-2.0

config SOC_SERIES_EFM32PG22
	bool "EFM32PG22 Series MCU"
	select ARM
	select CPU_CORTEX_M33
	select CPU_CORTEX_M_HAS_DWT
	select ARMV8_M_DSP
	select CPU_HAS_FPU
	select CPU_HAS_ARM_MPU
	select SOC_FAMILY_EXX32
	select HAS_SILABS_GECKO
	select HAS_SWO
	select SOC_GECKO_CMU
	select SOC_GECKO_EMU
	select SOC_GECKO_GPIO
	select SOC_GECKO_HAS_HFRCO_FREQRANGE
	select SOC_GECKO_TRNG
	help
	  Enable support for EFM32 PearlGecko MCU series
```
